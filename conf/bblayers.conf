## conf/bblayers.conf
```bitbake
# POKY_BBLAYERS_CONF_VERSION is increased each time build/conf/bblayers.conf
# changes incompatibly
POKY_BBLAYERS_CONF_VERSION = "2"

BBPATH = "${TOPDIR}"
BBFILES ?= ""

BBLAYERS ?= " \
  /home/dark/yocto_release/meta-olli \
  /home/dark/yocto_release/poky/meta \
  /home/dark/yocto_release/poky/meta-poky \
  /home/dark/yocto_release/poky/meta-openembedded/meta-oe \
  /home/dark/yocto_release/poky/meta-openembedded/meta-networking \
  /home/dark/yocto_release/poky/meta-openembedded/meta-python \
  /home/dark/yocto_release/poky/meta-openembedded/meta-multimedia \
  /home/dark/yocto_release/poky/meta-openembedded/meta-systemd \
"
```

## conf/local.conf
```bitbake
LICENSE_FLAGS_WHITELIST = "commercial"

DISTRO_FEATURES = "ext2 usbhost ${DISTRO_FEATURES_LIBC}"


# remove opengl so opencv builds cleanly, remove pulseaudio since it brings in x11
DISTRO_FEATURES_BACKFILL_CONSIDERED += "pulseaudio opengl"

PREFERRED_PROVIDER_jpeg = "libjpeg-turbo"

PREFERRED_PROVIDER_udev = "eudev"
VIRTUAL_RUNTIME_init_manager = "sysvinit"

# To change kernel version
PREFERRED_VERSION_olli-linux = "4.4%"

MACHINE = "beaglebone"

DISTRO = "poky"

PACKAGE_CLASSES ?= "package_ipk"

EXTRA_IMAGE_FEATURES = "debug-tweaks"

USER_CLASSES ?= "buildstats image-mklibs image-prelink"

PATCHRESOLVE = "noop"

RM_OLD_IMAGE = "1"

BB_DISKMON_DIRS = "\
    STOPTASKS,${TMPDIR},1G,100K \
    STOPTASKS,${DL_DIR},1G,100K \
    STOPTASKS,${SSTATE_DIR},1G,100K \
    STOPTASKS,/tmp,100M,100K \
    ABORT,${TMPDIR},100M,1K \
    ABORT,${DL_DIR},100M,1K \
    ABORT,${SSTATE_DIR},100M,1K \
    ABORT,/tmp,10M,1K"

#mgp123
LICENSE_FLAGS_WHITELIST_append = " commercial_mpg123"

LICENSE_FLAGS_WHITELIST_append = " commercial_ffmpeg"
LICENSE_FLAGS_WHITELIST_append = " commercial_x264"

DISTRO_FEATURES_append = " systemd"
VIRTUAL-RUNTIME_init_manager = "systemd"

INHERIT += "rm_work"

CONF_VERSION = "1"
```

## conf/machine/beaglebone.conf
```bitbake
#@TYPE: Machine
#@NAME: BeagleBone machine
#@DESCRIPTION: Machine configuration for the http://beagleboard.org/bone board 

SOC_FAMILY = "ti335x"
TARGET_ARCH = "arm"

DEFAULTTUNE ?= "cortexa8hf-neon"

require conf/machine/include/soc-family.inc
require conf/machine/include/tune-cortexa8.inc

PREFERRED_PROVIDER_virtual/kernel = "olli-linux"

PREFERRED_PROVIDER_virtual/bootloader = "u-boot-olli"
PREFERRED_PROVIDER_u-boot = "u-boot-olli"

KERNEL_IMAGETYPE = "zImage"

KERNEL_DEVICETREE = "am335x-bone.dtb am335x-boneblack.dtb am335x-bonegreen-wireless.dtb"

UBOOT_ARCH = "arm"
UBOOT_MACHINE = "am335x_evm_config"
UBOOT_ENTRYPOINT = "0x80008000"
UBOOT_LOADADDRESS = "0x80008000"

# List common SoC features, may need to add touchscreen for specific machines
MACHINE_FEATURES = "kernel26 apm usbgadget usbhost vfat ext2 screen alsa ethernet sgx bluetooth"

EXTRA_IMAGEDEPENDS += "u-boot-olli"

# Only has DVI connector for external screen
MACHINE_GUI_CLASS = "bigscreen"

WKS_FILE = "sdimage-bootpart.wks"
IMAGE_BOOT_FILES = "MLO u-boot.img"
IMAGE_FSTYPES += "tar.xz"

SERIAL_CONSOLE = "115200 ttyS0"

# Refine the list of device targets for ti-pdk class recipes
TI_PDK_LIMIT_BOARDS = "bbbAM335x"
```
